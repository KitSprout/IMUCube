/*====================================================================================================*/
/*====================================================================================================*/
#include "stm32f1_system.h"
#include "stm32f1_usart.h"
/*====================================================================================================*/
/*====================================================================================================*
**函數 : UART_SendByte
**功能 : Send Byte
**輸入 : USARTx, *sendByte
**輸出 : None
**使用 : UART_SendByte(USARTx, 'A');
**====================================================================================================*/
/*====================================================================================================*/
void UART_SendByte( USART_TypeDef *USARTx, uint8_t *sendByte )
{
  USARTx->DR = (*sendByte & (uint16_t)0x01FF);
  while(!USART_GetFlagStatus(USARTx, USART_FLAG_TXE));
}
/*====================================================================================================*/
/*====================================================================================================*
**函數 : UART_RecvByte
**功能 : Recv Byte
**輸入 : USARTx, *recvByte
**輸出 : None
**使用 : UART_RecvByte(USARTx, recvByte);
**====================================================================================================*/
/*====================================================================================================*/
void UART_RecvByte( USART_TypeDef *USARTx, uint8_t *recvByte )
{
  while(!USART_GetFlagStatus(USARTx, USART_FLAG_RXNE));
  *recvByte = (uint16_t)(USARTx->DR & (uint16_t)0x01FF);
}
/*====================================================================================================*/
/*====================================================================================================*
**函數 : UART_RecvByteWTO
**功能 : Recv Byte with Timeout
**輸入 : USARTx, *recvByte, timeout
**輸出 : state
**使用 : UART_RecvByteWTO(USARTx, recvByte, 200);
**====================================================================================================*/
/*====================================================================================================*/
int8_t UART_RecvByteWTO( USART_TypeDef *USARTx, uint8_t *recvByte, uint32_t timeout )
{
  while(!USART_GetFlagStatus(USARTx, USART_FLAG_RXNE)) {
    if(timeout-- > 0) {
      delay_ms(1);
    }
    else {
      return ERROR; // timeout
    }
  }
  *recvByte = (uint16_t)(USARTx->DR & (uint16_t)0x01FF);

  return SUCCESS;
}
/*====================================================================================================*/
/*====================================================================================================*
**函數 : UART_SendData
**功能 : Send Data
**輸入 : USARTx, *sendData, lens
**輸出 : None
**使用 : UART_SendData(USARTx, sendData, lens);
**====================================================================================================*/
/*====================================================================================================*/
void UART_SendData( USART_TypeDef *USARTx, uint8_t *sendData, uint16_t lens )
{
  do {
    UART_SendByte(USARTx, sendData++);
  } while(--lens);
}
/*====================================================================================================*/
/*====================================================================================================*
**函數 : UART_RecvData
**功能 : Recv Data
**輸入 : USARTx, *recvData, lens
**輸出 : None
**使用 : UART_RecvData(USARTx, RecvData, DataLen);
**====================================================================================================*/
/*====================================================================================================*/
void UART_RecvData( USART_TypeDef *USARTx, uint8_t *recvData, uint16_t lens )
{
  do {
    UART_RecvByte(USARTx, recvData++);
  } while(--lens);
}
/*====================================================================================================*/
/*====================================================================================================*
**函數 : UART_RecvDataWTO
**功能 : Recv Bytes with Timeout
**輸入 : USARTx, *recvData, lens, timeout
**輸出 : state
**使用 : UART_RecvDataWTO(USARTx, recvData, lens, 200);
**====================================================================================================*/
/*====================================================================================================*/
int8_t UART_RecvDataWTO( USART_TypeDef *USARTx, uint8_t *recvData, uint16_t lens, uint32_t timeout )
{
  int8_t state = ERROR;

  do {
    state = UART_RecvByteWTO(USARTx, recvData++, timeout);
  } while((--lens) && (state != ERROR));

  return state;
}
/*====================================================================================================*/
/*====================================================================================================*/
